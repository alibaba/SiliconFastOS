## package/kmod/Kconfig
```kconfig
menuconfig PACKAGE_KMOD
	bool "kmod"

if PACKAGE_KMOD
menuconfig KMOD_BIN
	bool "kmod_bin"
if KMOD_BIN
config KMOD_DEPMOD
	bool "depmod"
config KMOD_INSMOD
	bool "insmod"
config KMOD_KMOD
	bool "kmod"
config KMOD_LSMOD
	bool "lsmod"
config KMOD_MODINFO
	bool "modinfo"
config KMOD_MODPROBE
	bool "modprobe"
config KMOD_RMMOD
	bool "rmmod"
endif
menuconfig KMOD_SBIN
	bool "kmod_sbin"
if KMOD_SBIN
endif
menuconfig KMOD_LIB
	bool "kmod_lib"
if KMOD_LIB
config KMOD_LIBKMOD_LA
	bool "libkmod_la"
config KMOD_LIBKMOD_SO
	bool "libkmod_so"
config KMOD_LIBKMOD_SO_2
	bool "libkmod_so_2"
config KMOD_LIBKMOD_SO_2_3_6
	bool "libkmod_so_2_3_6"
endif
endif
```

## package/libbpf/Kconfig
```kconfig
menuconfig PACKAGE_LIBBPF
	bool "libbpf"
if PACKAGE_LIBBPF
menuconfig LIBBPF_BIN
	bool "libbpf_bin"
if LIBBPF_BIN
endif
menuconfig LIBBPF_SBIN
	bool "libbpf_sbin"
if LIBBPF_SBIN
endif
menuconfig LIBBPF_LIB
	bool "libbpf_lib"
if LIBBPF_LIB
config LIBBPF_LIBBPF_SO_0
	bool "libbpf_so_0"
config LIBBPF_LIBBPF_SO_0_4_0
	bool "libbpf_so_0_4_0"
endif
endif
```

## package/libcap/Kconfig
```kconfig
menuconfig PACKAGE_LIBCAP
	bool "libcap"
if PACKAGE_LIBCAP
menuconfig LIBCAP_BIN
	bool "libcap_bin"
if LIBCAP_BIN
endif
menuconfig LIBCAP_SBIN
	bool "libcap_sbin"
if LIBCAP_SBIN
config LIBCAP_CAPSH
	bool "capsh"
config LIBCAP_GETCAP
	bool "getcap"
config LIBCAP_GETPCAPS
	bool "getpcaps"
config LIBCAP_SETCAP
	bool "setcap"
endif
menuconfig LIBCAP_LIB
	bool "libcap_lib"
if LIBCAP_LIB
config LIBCAP_LIBCAP_SO
	bool "libcap_so"
config LIBCAP_LIBCAP_SO_2
	bool "libcap_so_2"
endif
endif
```

## package/libmnl/Kconfig
```kconfig
menuconfig PACKAGE_LIBMNL
	bool "libmnl"
if PACKAGE_LIBMNL
menuconfig LIBMNL_BIN
	bool "libmnl_bin"
if LIBMNL_BIN
endif
menuconfig LIBMNL_SBIN
	bool "libmnl_sbin"
if LIBMNL_SBIN
endif
menuconfig LIBMNL_LIB
	bool "libmnl_lib"
if LIBMNL_LIB
config LIBMNL_LIBMNL_SO_0
	bool "libmnl_so_0"
config LIBMNL_LIBMNL_SO_0_2_0
	bool "libmnl_so_0_2_0"
endif
endif
```

## package/libselinux/Kconfig
```kconfig
menuconfig PACKAGE_LIBSELINUX
	bool "libselinux"
if PACKAGE_LIBSELINUX
menuconfig LIBSELINUX_BIN
	bool "libselinux_bin"
if LIBSELINUX_BIN
endif
menuconfig LIBSELINUX_SBIN
	bool "libselinux_sbin"
if LIBSELINUX_SBIN
endif
menuconfig LIBSELINUX_LIB
	bool "libselinux_lib"
if LIBSELINUX_LIB
config LIBSELINUX_LIBSELINUX_SO_1
	bool "libselinux_so_1"
endif
endif
```

## package/linux/Kconfig
```kconfig
menuconfig PACKAGE_LINUX
	bool "linux"
if PACKAGE_LINUX
menuconfig LINUX_BIN
	bool "linux_bin"
if LINUX_BIN
endif
menuconfig LINUX_SBIN
	bool "linux_sbin"
if LINUX_SBIN
endif
menuconfig LINUX_LIB
	bool "linux_lib"
if LINUX_LIB
endif
endif
if PACKAGE_LINUX
menuconfig LINUX_BIN
	bool "linux_bin"
if LINUX_BIN
endif
menuconfig LINUX_SBIN
	bool "linux_sbin"
if LINUX_SBIN
endif
menuconfig LINUX_LIB
	bool "linux_lib"
if LINUX_LIB
endif
endif
if PACKAGE_LINUX
menuconfig LINUX_BIN
	bool "linux_bin"
if LINUX_BIN
endif
menuconfig LINUX_SBIN
	bool "linux_sbin"
if LINUX_SBIN
endif
menuconfig LINUX_LIB
	bool "linux_lib"
if LINUX_LIB
endif
endif
```

## package/ncurses/Kconfig
```kconfig
menuconfig PACKAGE_NCURSES
	bool "ncurses"
if PACKAGE_NCURSES
menuconfig NCURSES_BIN
	bool "ncurses_bin"
if NCURSES_BIN
endif
menuconfig NCURSES_SBIN
	bool "ncurses_sbin"
if NCURSES_SBIN
endif
menuconfig NCURSES_LIB
	bool "ncurses_lib"
if NCURSES_LIB
config NCURSES_LIBFORM_SO_6
	bool "libform_so_6"
config NCURSES_LIBFORM_SO_6_1
	bool "libform_so_6_1"
config NCURSES_LIBFORMW_SO_6
	bool "libformw_so_6"
config NCURSES_LIBFORMW_SO_6_1
	bool "libformw_so_6_1"
config NCURSES_LIBMENU_SO_6
	bool "libmenu_so_6"
config NCURSES_LIBMENU_SO_6_1
	bool "libmenu_so_6_1"
config NCURSES_LIBMENUW_SO_6
	bool "libmenuw_so_6"
config NCURSES_LIBMENUW_SO_6_1
	bool "libmenuw_so_6_1"
config NCURSES_LIBNCURSES_SO_6
	bool "libncurses_so_6"
config NCURSES_LIBNCURSES_SO_6_1
	bool "libncurses_so_6_1"
config NCURSES_LIBNCURSESW_SO_6
	bool "libncursesw_so_6"
config NCURSES_LIBNCURSESW_SO_6_1
	bool "libncursesw_so_6_1"
config NCURSES_LIBPANEL_SO_6
	bool "libpanel_so_6"
config NCURSES_LIBPANEL_SO_6_1
	bool "libpanel_so_6_1"
config NCURSES_LIBPANELW_SO_6
	bool "libpanelw_so_6"
config NCURSES_LIBPANELW_SO_6_1
	bool "libpanelw_so_6_1"
config NCURSES_LIBTIC_SO_6
	bool "libtic_so_6"
config NCURSES_LIBTIC_SO_6_1
	bool "libtic_so_6_1"
config NCURSES_LIBTINFO_SO_6
	bool "libtinfo_so_6"
config NCURSES_LIBTINFO_SO_6_1
	bool "libtinfo_so_6_1"
endif
endif
```

## package/net-tools/Kconfig
```kconfig
menuconfig PACKAGE_NET-TOOLS
	bool "net-tools"
if PACKAGE_NET-TOOLS
menuconfig NET-TOOLS_BIN
	bool "net-tools_bin"
if NET-TOOLS_BIN
config NET-TOOLS_DNSDOMAINNAME
	bool "dnsdomainname"
config NET-TOOLS_DOMAINNAME
	bool "domainname"
config NET-TOOLS_HOSTNAME
	bool "hostname"
config NET-TOOLS_IFCONFIG
	bool "ifconfig"
config NET-TOOLS_NETSTAT
	bool "netstat"
config NET-TOOLS_NISDOMAINNAME
	bool "nisdomainname"
config NET-TOOLS_ROUTE
	bool "route"
config NET-TOOLS_YPDOMAINNAME
	bool "ypdomainname"
endif
menuconfig NET-TOOLS_SBIN
	bool "net-tools_sbin"
if NET-TOOLS_SBIN
config NET-TOOLS_ARP
	bool "arp"
config NET-TOOLS_IPMADDR
	bool "ipmaddr"
config NET-TOOLS_IPTUNNEL
	bool "iptunnel"
config NET-TOOLS_MII-TOOL
	bool "mii-tool"
config NET-TOOLS_NAMEIF
	bool "nameif"
config NET-TOOLS_PLIPCONFIG
	bool "plipconfig"
config NET-TOOLS_RARP
	bool "rarp"
config NET-TOOLS_SLATTACH
	bool "slattach"
endif
menuconfig NET-TOOLS_LIB
	bool "net-tools_lib"
if NET-TOOLS_LIB
endif
endif
```
