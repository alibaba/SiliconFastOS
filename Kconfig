## Kconfig
```kconfig
#
# For a description of the syntax of this configuration file,
# see Documentation/kbuild/kconfig-language.txt.
#
mainmenu "SiliconFastOS Configuration"

choice
    prompt "SoftWare Repo"
    default ANOLIS_PACKAGE_REPO

config ANOLIS_PACKAGE_REPO
    bool "Anolis repo"

config OPENSOURCE_PACKAGE_REPO
    bool "Opensource repp"

endchoice


menu "Share Library"
    source "package/acl/Kconfig"
    source "package/attr/Kconfig"
    source "package/glibc/Kconfig"
    source "package/libcap/Kconfig"
    source "package/pcre/Kconfig"
    source "package/pcre2/Kconfig"
    source "package/libselinux/Kconfig"
    source "package/libbpf/Kconfig"
    source "package/elfutils/Kconfig"
    source "package/libmnl/Kconfig"
    source "package/zlib/Kconfig"
endmenu

menu "Archival Utilities"
    source "package/busybox/Kconfig"
    source "package/linux/Kconfig"
endmenu

menu "Coreutils"
    source "package/coreutils/Kconfig"
endmenu

menu "Console Utilities"
    source "package/ncurses/Kconfig"
endmenu

menu "Finding Utilities"
    source "package/findutils/Kconfig"
endmenu

menu "Init Utilities"

endmenu

menu "Login/Password Management Utilities"
    source "package/openssh/Kconfig"
    source "package/dropbear/Kconfig"
endmenu

menu "Linux Module Utilities"
    source "package/kmod/Kconfig"
endmenu

menu "Linux System Utilities"
    source "package/pciutils/Kconfig"
    source "package/util-linux/Kconfig"
endmenu

menu "Miscellaneous Utilities"

endmenu

menu "Networking Utilities"
    source "package/net-tools/Kconfig"
    source "package/iproute2/Kconfig"
    source "package/iproute/Kconfig"
    source "package/iputils/Kconfig"
endmenu

menu "Shells"
    source "package/bash/Kconfig"
endmenu

menu "System Logging Utilities"

endmenu

menu "Silicon Validation framework and test suite"
    source "package/bee/Kconfig"
endmenu
```

## package/Kconfig
```kconfig
menu "Target packages"

    source "package/bash/Kconfig"
    source "package/bee/Kconfig"
    source "package/busybox/Kconfig"
    source "package/coreutils/Kconfig"
    source "package/findutils/Kconfig"
    source "package/glibc/Kconfig"
    source "package/iproute2/Kconfig"
    source "package/iputils/Kconfig"
    source "package/linux/Kconfig"
    source "package/net-tools/Kconfig"
    source "package/openssh/Kconfig"
    source "package/pciutils/Kconfig"
    source "package/util-linux/Kconfig"
    source "package/kmod/Kconfig"
    source "package/attr/Kconfig"
    source "package/pcre/Kconfig"
    source "package/libcap/Kconfig"
    source "package/libselinux/Kconfig"

endmenu
```

## package/acl/Kconfig
```kconfig
menuconfig PACKAGE_ACL
	bool "acl"
if PACKAGE_ACL
menuconfig ACL_BIN
	bool "acl_bin"
if ACL_BIN
config ACL_CHACL
	bool "chacl"
config ACL_GETFACL
	bool "getfacl"
config ACL_SETFACL
	bool "setfacl"
endif
menuconfig ACL_LIB
	bool "acl_lib"
if ACL_LIB
config ACL_LIBACL_SO
	bool "libacl_so"
config ACL_LIBACL_SO_1
	bool "libacl_so_1"
endif
endif
```

## package/attr/Kconfig
```kconfig
menuconfig PACKAGE_ATTR
	bool "attr"
if PACKAGE_ATTR
menuconfig ATTR_BIN
	bool "attr_bin"
if ATTR_BIN
config ATTR_ATTR
	bool "attr"
config ATTR_GETFATTR
	bool "getfattr"
config ATTR_SETFATTR
	bool "setfattr"
endif
menuconfig ATTR_LIB
	bool "attr_lib"
if ATTR_LIB
config ATTR_LIBATTR_SO
	bool "libattr_so"
config ATTR_LIBATTR_SO_1
	bool "libattr_so_1"
endif
endif
```

## package/bash/Kconfig
```kconfig
menuconfig PACKAGE_BASH
	bool "bash"
if PACKAGE_BASH
menuconfig BASH_BIN
	bool "bash_bin"
if BASH_BIN
config BASH_BASH
	bool "bash"
config BASH_BASHBUG
	bool "bashbug"
endif
menuconfig BASH_LIB
	bool "bash_lib"
if BASH_LIB
endif
endif
```

## package/busybox/Kconfig
```kconfig
menuconfig PACKAGE_BUSYBOX
	bool "busybox"
if PACKAGE_BUSYBOX
menuconfig BUSYBOX_BIN
	bool "busybox_bin"
if BUSYBOX_BIN
endif
menuconfig BUSYBOX_SBIN
	bool "busybox_sbin"
if BUSYBOX_SBIN
endif
menuconfig BUSYBOX_LIB
	bool "busybox_lib"
if BUSYBOX_LIB
endif
endif
```

## package/coreutils/Kconfig
```kconfig
menuconfig PACKAGE_COREUTILS
	bool "coreutils"
if PACKAGE_COREUTILS
menuconfig COREUTILS_BIN
	bool "coreutils_bin"
if COREUTILS_BIN
config COREUTILS_TEST
	bool "test"
config COREUTILS_B2SUM
	bool "b2sum"
config COREUTILS_BASE32
	bool "base32"
config COREUTILS_BASE64
	bool "base64"
config COREUTILS_BASENAME
	bool "basename"
config COREUTILS_BASENC
	bool "basenc"
config COREUTILS_CAT
	bool "cat"
config COREUTILS_CHCON
	bool "chcon"
config COREUTILS_CHGRP
	bool "chgrp"
config COREUTILS_CHMOD
	bool "chmod"
config COREUTILS_CHOWN
	bool "chown"
config COREUTILS_CHROOT
	bool "chroot"
config COREUTILS_CKSUM
	bool "cksum"
config COREUTILS_COMM
	bool "comm"
config COREUTILS_CP
	bool "cp"
config COREUTILS_CSPLIT
	bool "csplit"
config COREUTILS_CUT
	bool "cut"
config COREUTILS_DATE
	bool "date"
config COREUTILS_DD
	bool "dd"
config COREUTILS_DF
	bool "df"
config COREUTILS_DIR
	bool "dir"
config COREUTILS_DIRCOLORS
	bool "dircolors"
config COREUTILS_DIRNAME
	bool "dirname"
config COREUTILS_DU
	bool "du"
config COREUTILS_ECHO
	bool "echo"
config COREUTILS_ENV
	bool "env"
config COREUTILS_EXPAND
	bool "expand"
config COREUTILS_EXPR
	bool "expr"
config COREUTILS_FACTOR
	bool "factor"
config COREUTILS_FALSE
	bool "false"
config COREUTILS_FMT
	bool "fmt"
config COREUTILS_FOLD
	bool "fold"
config COREUTILS_GROUPS
	bool "groups"
config COREUTILS_HEAD
	bool "head"
config COREUTILS_HOSTID
	bool "hostid"
config COREUTILS_ID
	bool "id"
config COREUTILS_INSTALL
	bool "install"
config COREUTILS_JOIN
	bool "join"
config COREUTILS_KILL
	bool "kill"
config COREUTILS_LINK
	bool "link"
config COREUTILS_LN
	bool "ln"
config COREUTILS_LOGNAME
	bool "logname"
config COREUTILS_LS
	bool "ls"
config COREUTILS_MD5SUM
	bool "md5sum"
config COREUTILS_MKDIR
	bool "mkdir"
config COREUTILS_MKFIFO
	bool "mkfifo"
config COREUTILS_MKNOD
	bool "mknod"
config COREUTILS_MKTEMP
	bool "mktemp"
config COREUTILS_MV
	bool "mv"
config COREUTILS_NICE
	bool "nice"
config COREUTILS_NL
	bool "nl"
config COREUTILS_NOHUP
	bool "nohup"
config COREUTILS_NPROC
	bool "nproc"
config COREUTILS_NUMFMT
	bool "numfmt"
config COREUTILS_OD
	bool "od"
config COREUTILS_PASTE
	bool "paste"
config COREUTILS_PATHCHK
	bool "pathchk"
config COREUTILS_PINKY
	bool "pinky"
config COREUTILS_PR
	bool "pr"
config COREUTILS_PRINTENV
	bool "printenv"
config COREUTILS_PRINTF
	bool "printf"
config COREUTILS_PTX
	bool "ptx"
config COREUTILS_PWD
	bool "pwd"
config COREUTILS_READLINK
	bool "readlink"
config COREUTILS_REALPATH
	bool "realpath"
config COREUTILS_RM
	bool "rm"
config COREUTILS_RMDIR
	bool "rmdir"
config COREUTILS_RUNCON
	bool "runcon"
config COREUTILS_SEQ
	bool "seq"
config COREUTILS_SHA1SUM
	bool "sha1sum"
config COREUTILS_SHA224SUM
	bool "sha224sum"
config COREUTILS_SHA256SUM
	bool "sha256sum"
config COREUTILS_SHA384SUM
	bool "sha384sum"
config COREUTILS_SHA512SUM
	bool "sha512sum"
config COREUTILS_SHRED
	bool "shred"
config COREUTILS_SHUF
	bool "shuf"
config COREUTILS_SLEEP
	bool "sleep"
config COREUTILS_SORT
	bool "sort"
config COREUTILS_SPLIT
	bool "split"
config COREUTILS_STAT
	bool "stat"
config COREUTILS_STDBUF
	bool "stdbuf"
config COREUTILS_STTY
	bool "stty"
config COREUTILS_SUM
	bool "sum"
config COREUTILS_SYNC
	bool "sync"
config COREUTILS_TAC
	bool "tac"
config COREUTILS_TAIL
	bool "tail"
config COREUTILS_TEE
	bool "tee"
config COREUTILS_TEST
	bool "test"
config COREUTILS_TIMEOUT
	bool "timeout"
config COREUTILS_TOUCH
	bool "touch"
config COREUTILS_TR
	bool "tr"
config COREUTILS_TRUE
	bool "true"
config COREUTILS_TRUNCATE
	bool "truncate"
config COREUTILS_TSORT
	bool "tsort"
config COREUTILS_TTY
	bool "tty"
config COREUTILS_UNAME
	bool "uname"
config COREUTILS_UNEXPAND
	bool "unexpand"
config COREUTILS_UNIQ
	bool "uniq"
config COREUTILS_UNLINK
	bool "unlink"
config COREUTILS_UPTIME
	bool "uptime"
config COREUTILS_USERS
	bool "users"
config COREUTILS_VDIR
	bool "vdir"
config COREUTILS_WC
	bool "wc"
config COREUTILS_WHO
	bool "who"
config COREUTILS_WHOAMI
	bool "whoami"
config COREUTILS_YES
	bool "yes"
endif
menuconfig COREUTILS_LIB
	bool "coreutils_lib"
if COREUTILS_LIB
endif
endif
```

## package/dropbear/Kconfig
```kconfig
menuconfig PACKAGE_DROPBEAR
	bool "dropbear"
if PACKAGE_DROPBEAR
menuconfig DROPBEAR_BIN
	bool "dropbear_bin"
if DROPBEAR_BIN
config DROPBEAR_DBCLIENT
	bool "dbclient"
config DROPBEAR_DROPBEARCONVERT
	bool "dropbearconvert"
config DROPBEAR_DROPBEARKEY
	bool "dropbearkey"
endif
menuconfig DROPBEAR_SBIN
	bool "dropbear_sbin"
if DROPBEAR_SBIN
config DROPBEAR_DROPBEAR
	bool "dropbear"
endif
menuconfig DROPBEAR_LIB
	bool "dropbear_lib"
if DROPBEAR_LIB
endif
endif
```

## package/elfutils/Kconfig
```kconfig
menuconfig PACKAGE_ELFUTILS
	bool "elfutils"
if PACKAGE_ELFUTILS
menuconfig ELFUTILS_BIN
	bool "elfutils_bin"
if ELFUTILS_BIN
config ELFUTILS_EU-ADDR2LINE
	bool "eu-addr2line"
config ELFUTILS_EU-AR
	bool "eu-ar"
config ELFUTILS_EU-ELFCLASSIFY
	bool "eu-elfclassify"
config ELFUTILS_EU-ELFCMP
	bool "eu-elfcmp"
config ELFUTILS_EU-ELFCOMPRESS
	bool "eu-elfcompress"
config ELFUTILS_EU-ELFLINT
	bool "eu-elflint"
config ELFUTILS_EU-FINDTEXTREL
	bool "eu-findtextrel"
config ELFUTILS_EU-MAKE-DEBUG-ARCHIVE
	bool "eu-make-debug-archive"
config ELFUTILS_EU-NM
	bool "eu-nm"
config ELFUTILS_EU-OBJDUMP
	bool "eu-objdump"
config ELFUTILS_EU-RANLIB
	bool "eu-ranlib"
config ELFUTILS_EU-READELF
	bool "eu-readelf"
config ELFUTILS_EU-SIZE
	bool "eu-size"
config ELFUTILS_EU-STACK
	bool "eu-stack"
config ELFUTILS_EU-STRINGS
	bool "eu-strings"
config ELFUTILS_EU-STRIP
	bool "eu-strip"
config ELFUTILS_EU-UNSTRIP
	bool "eu-unstrip"
endif
menuconfig ELFUTILS_SBIN
	bool "elfutils_sbin"
if ELFUTILS_SBIN
endif
menuconfig ELFUTILS_LIB
	bool "elfutils_lib"
if ELFUTILS_LIB
config ELFUTILS_LIBELF-0_185_SO
	bool "libelf-0_185_so"
config ELFUTILS_LIBELF_SO_1
	bool "libelf_so_1"
endif
endif
```

## package/findutils/Kconfig
```kconfig
menuconfig PACKAGE_FINDUTILS
	bool "finduilts"
if PACKAGE_FINDUTILS
menuconfig FINDUTILS_BIN
	bool "findutils_bin"
if FINDUTILS_BIN
config FINDUTILS_FIND
	bool "find"
config FINDUTILS_LOCATE
	bool "locate"
config FINDUTILS_UPDATEDB
	bool "updatedb"
config FINDUTILS_XARGS
	bool "xargs"
endif
menuconfig FINDUTILS_LIB
	bool "findutils_lib"
if FINDUTILS_LIB
endif
endif
```

## package/glibc/Kconfig
```kconfig
menuconfig PACKAGE_GLIBC
	bool "glibc"

if PACKAGE_GLIBC
menuconfig GLIBC_BIN
	bool "glibc_bin"
if GLIBC_BIN
config GLIBC_CATCHSEGV
	bool "catchsegv"
config GLIBC_GENCAT
	bool "gencat"
config GLIBC_GETCONF
	bool "getconf"
config GLIBC_GETENT
	bool "getent"
config GLIBC_ICONV
	bool "iconv"
config GLIBC_LDD
	bool "ldd"
config GLIBC_LOCALE
	bool "locale"
config GLIBC_LOCALEDEF
	bool "localedef"
config GLIBC_MAKEDB
	bool "makedb"
config GLIBC_MTRACE
	bool "mtrace"
config GLIBC_PCPROFILEDUMP
	bool "pcprofiledump"
config GLIBC_PLDD
	bool "pldd"
config GLIBC_SOTRUSS
	bool "sotruss"
config GLIBC_SPROF
	bool "sprof"
config GLIBC_TZSELECT
	bool "tzselect"
config GLIBC_XTRACE
	bool "xtrace"
endif
menuconfig GLIBC_SBIN
	bool "glibc_sbin"
if GLIBC_SBIN
config GLIBC_ICONVCONFIG
	bool "iconvconfig"
config GLIBC_LDCONFIG
	bool "ldconfig"
config GLIBC_NSCD
	bool "nscd"
config GLIBC_SLN
	bool "sln"
config GLIBC_ZDUMP
	bool "zdump"
config GLIBC_ZIC
	bool "zic"
endif
menuconfig GLIBC_LIB
	bool "glibc_lib"
if GLIBC_LIB
config GLIBC_LD-LINUX-AARCH64_SO_1
	bool "ld-linux-aarch64_so_1"
config GLIBC_LIBANL_SO
	bool "libanl_so"
config GLIBC_LIBANL_SO_1
	bool "libanl_so_1"
config GLIBC_LIBBROKENLOCALE_SO
	bool "libBrokenLocale_so"
config GLIBC_LIBBROKENLOCALE_SO_1
	bool "libBrokenLocale_so_1"
config GLIBC_LIBCRYPT_SO
	bool "libcrypt_so"
config GLIBC_LIBCRYPT_SO_1
	bool "libcrypt_so_1"
config GLIBC_LIBC_SO
	bool "libc_so"
config GLIBC_LIBC_SO_6
	bool "libc_so_6"
config GLIBC_LIBDL_SO
	bool "libdl_so"
config GLIBC_LIBDL_SO_2
	bool "libdl_so_2"
config GLIBC_LIBMEMUSAGE_SO
	bool "libmemusage_so"
config GLIBC_LIBM_SO
	bool "libm_so"
config GLIBC_LIBM_SO_6
	bool "libm_so_6"
config GLIBC_LIBNSL_SO_1
	bool "libnsl_so_1"
config GLIBC_LIBNSS_COMPAT_SO
	bool "libnss_compat_so"
config GLIBC_LIBNSS_COMPAT_SO_2
	bool "libnss_compat_so_2"
config GLIBC_LIBNSS_DB_SO
	bool "libnss_db_so"
config GLIBC_LIBNSS_DB_SO_2
	bool "libnss_db_so_2"
config GLIBC_LIBNSS_DNS_SO
	bool "libnss_dns_so"
config GLIBC_LIBNSS_DNS_SO_2
	bool "libnss_dns_so_2"
config GLIBC_LIBNSS_FILES_SO
	bool "libnss_files_so"
config GLIBC_LIBNSS_FILES_SO_2
	bool "libnss_files_so_2"
config GLIBC_LIBNSS_HESIOD_SO
	bool "libnss_hesiod_so"
config GLIBC_LIBNSS_HESIOD_SO_2
	bool "libnss_hesiod_so_2"
config GLIBC_LIBPCPROFILE_SO
	bool "libpcprofile_so"
config GLIBC_LIBPTHREAD_SO
	bool "libpthread_so"
config GLIBC_LIBPTHREAD_SO_0
	bool "libpthread_so_0"
config GLIBC_LIBRESOLV_SO
	bool "libresolv_so"
config GLIBC_LIBRESOLV_SO_2
	bool "libresolv_so_2"
config GLIBC_LIBRT_SO
	bool "librt_so"
config GLIBC_LIBRT_SO_1
	bool "librt_so_1"
config GLIBC_LIBSEGFAULT_SO
	bool "libSegFault_so"
config GLIBC_LIBTHREAD_DB_SO
	bool "libthread_db_so"
config GLIBC_LIBTHREAD_DB_SO_1
	bool "libthread_db_so_1"
config GLIBC_LIBUTIL_SO
	bool "libutil_so"
config GLIBC_LIBUTIL_SO_1
	bool "libutil_so_1"
endif
endif
```

## package/iproute/Kconfig
```kconfig
menuconfig PACKAGE_IPROUTE
	bool "iproute"

if PACKAGE_IPROUTE
menuconfig IPROUTE_BIN
	bool "iproute_bin"
if IPROUTE_BIN
endif
menuconfig IPROUTE_SBIN
	bool "iproute_sbin"
if IPROUTE_SBIN
config IPROUTE_ARPD
	bool "arpd"
config IPROUTE_BRIDGE
	bool "bridge"
config IPROUTE_CTSTAT
	bool "ctstat"
config IPROUTE_DCB
	bool "dcb"
config IPROUTE_DEVLINK
	bool "devlink"
config IPROUTE_GENL
	bool "genl"
config IPROUTE_IFCFG
	bool "ifcfg"
config IPROUTE_IFSTAT
	bool "ifstat"
config IPROUTE_IP
	bool "ip"
config IPROUTE_LNSTAT
	bool "lnstat"
config IPROUTE_NSTAT
	bool "nstat"
config IPROUTE_RDMA
	bool "rdma"
config IPROUTE_ROUTEF
	bool "routef"
config IPROUTE_ROUTEL
	bool "routel"
config IPROUTE_RTACCT
	bool "rtacct"
config IPROUTE_RTMON
	bool "rtmon"
config IPROUTE_RTPR
	bool "rtpr"
config IPROUTE_RTSTAT
	bool "rtstat"
config IPROUTE_SS
	bool "ss"
config IPROUTE_TIPC
	bool "tipc"
config IPROUTE_VDPA
	bool "vdpa"
endif
menuconfig IPROUTE_LIB
	bool "iproute_lib"
if IPROUTE_LIB
endif
endif
```

## package/iproute2/Kconfig
```kconfig
menuconfig PACKAGE_IPROUTE2
	bool "iproute2"

if PACKAGE_IPROUTE2
menuconfig IPROUTE2_BIN
	bool "iproute2_bin"
if IPROUTE2_BIN
endif
menuconfig IPROUTE2_SBIN
	bool "iproute2_sbin"
if IPROUTE2_SBIN
config IPROUTE2_ARPD
	bool "arpd"
config IPROUTE2_BRIDGE
	bool "bridge"
config IPROUTE2_CTSTAT
	bool "ctstat"
config IPROUTE2_GENL
	bool "genl"
config IPROUTE2_IFCFG
	bool "ifcfg"
config IPROUTE2_IFSTAT
	bool "ifstat"
config IPROUTE2_IP
	bool "ip"
config IPROUTE2_LNSTAT
	bool "lnstat"
config IPROUTE2_NSTAT
	bool "nstat"
config IPROUTE2_ROUTEF
	bool "routef"
config IPROUTE2_ROUTEL
	bool "routel"
config IPROUTE2_RTACCT
	bool "rtacct"
config IPROUTE2_RTMON
	bool "rtmon"
config IPROUTE2_RTPR
	bool "rtpr"
config IPROUTE2_RTSTAT
	bool "rtstat"
config IPROUTE2_SS
	bool "ss"
config IPROUTE2_TC
	bool "tc"
endif
menuconfig IPROUTE2_LIB
	bool "iproute2_lib"
if IPROUTE2_LIB
endif
endif
```

## package/iputils/Kconfig
```kconfig
menuconfig PACKAGE_IPUTILS
	bool "iputils"

if PACKAGE_IPUTILS
menuconfig IPUTILS_BIN
	bool "iputils_bin"
if IPUTILS_BIN
config IPUTILS_ARPING
	bool "arping"
config IPUTILS_CLOCKDIFF
	bool "clockdiff"
config IPUTILS_IPG
	bool "ipg"
config IPUTILS_PING
	bool "ping"
config IPUTILS_PING6
	bool "ping6"
config IPUTILS_RARPD
	bool "rarpd"
config IPUTILS_RDISC
	bool "rdisc"
config IPUTILS_TFTPD
	bool "tftpd"
config IPUTILS_TRACEPATH
	bool "tracepath"
config IPUTILS_TRACEPATH6
	bool "tracepath6"
config IPUTILS_TRACEROUTE6
	bool "traceroute6"
endif
menuconfig IPUTILS_SBIN
	bool "iputils_sbin"
if IPUTILS_SBIN
endif
menuconfig IPUTILS_LIB
	bool "iputils_lib"
if IPUTILS_LIB
endif
endif
```
